
/dts-v1/;
#include <nordic/nrf9151_laca.dtsi>
#include "customboard_nrf9151_common.dtsi"

/ {
  chosen {
    zephyr,flash = &flash0;
    zephyr,sram = &sram0_s;
    zephyr,code-partition = &slot0_partition;
    zephyr,sram-secure-partition = &sram0_s;
    zephyr,sram-non-secure-partition = &sram0_ns;
  };
};
