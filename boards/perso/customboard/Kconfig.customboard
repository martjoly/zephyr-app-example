## boards/perso/customboard/Kconfig.customboard
```kconfig
config BOARD_CUSTOMBOARD
	select SOC_STM32H562XX if BOARD_CUSTOMBOARD_STM32H562XX || BOARD_CUSTOMBOARD_STM32H562XX_NS
	select SOC_NRF9151_LACA if BOARD_CUSTOMBOARD_NRF9151 || BOARD_CUSTOMBOARD_NRF9151_NS
```

## boards/perso/customboard/board.yml
```yaml
board:
  name: customboard
  full_name: CustomBoard
  vendor: perso
  socs:
  - name: stm32h562xx
    variants:
    - name: 'ns'
  - name: nrf9151
    variants:
    - name: 'ns'
  revision:
    format: letter
    default: A
    revisions:
    - name: A
```

## boards/perso/customboard/customboard_stm32h562xx_defconfig
```kconfig
# Enable MPU
CONFIG_ARM_MPU=y

# Enable hardware stack protection
CONFIG_HW_STACK_PROTECTION=y

# Enable TrustZone-M
CONFIG_ARM_TRUSTZONE_M=y

# Enable uart driver
CONFIG_SERIAL=y

# Console
CONFIG_CONSOLE=y
CONFIG_UART_CONSOLE=y

# Enable GPIO
CONFIG_GPIO=y
```
